;**************************************************************
;*     File: regioninit.s                                     *
;*  Purpose: Application Startup Code                         *
;**************************************************************
;
; This file contains the macro and supporting subroutines to
; copy RO code and RW data from ROM to RAM and zero-initialize
; the ZI data areas in RAM.

        AREA Macros, CODE, READONLY

        EXPORT InitRegions

		IMPORT hyhwArm926e_writeBackDcache
		IMPORT hyhwArm926ejs_drainWriteBuffer
		IMPORT hyhwArm926ejs_invalidIcacheDcache
		IMPORT hyhwArm926ejs_invalidateIcache
		
; This macro:
; a) copies RO code and/or RW data from ROM at Load$$area$$Base
; to RAM at Image$$area$$Base, of length Image$$area$$Length bytes.
; b) fills with zero the ZI data in RAM at Image$$area$$ZI$$Base, 
; of length Image$$area$$ZI$$Length bytes.

        MACRO
        macro_RWZI_Init $areaname

        LCLS   namecp
        LCLS   copyloadsym
        LCLS   copybasesym
        LCLS   copylensym
        LCLS   zibasesym
        LCLS   zilensym

namecp SETS "$areaname"

copyloadsym SETS  "|Load$$$$":CC:namecp:CC:"$$$$Base|"
copybasesym SETS  "|Image$$$$":CC:namecp:CC:"$$$$Base|"
copylensym  SETS  "|Image$$$$":CC:namecp:CC:"$$$$Length|"
zibasesym   SETS  "|Image$$$$":CC:namecp:CC:"$$$$ZI$$$$Base|"
zilensym    SETS  "|Image$$$$":CC:namecp:CC:"$$$$ZI$$$$Length|"


; The following symbols are generated by the linker.  They are imported 
; WEAKly because they may not all have defined values. Those which are
; undefined will take the value zero.

        IMPORT $copyloadsym, WEAK
        IMPORT $copybasesym, WEAK
        IMPORT $copylensym, WEAK
        IMPORT $zibasesym, WEAK
        IMPORT $zilensym, WEAK


        BL	hyhwArm926e_writeBackDcache
        BL	hyhwArm926ejs_drainWriteBuffer
        BL	hyhwArm926ejs_invalidIcacheDcache
        
        LDR     r0, =$copyloadsym       ; load address of region
        LDR     r1, =$copybasesym       ; execution address of region
        MOV     r2, r1                  ; copy execution address into r2
        LDR     r4, =$copylensym
        ADD     r2, r2, r4              ; add region length to execution address to...
                                        ; ...calculate address of word beyond end...
                                        ; ... of execution region
        CMP     r0,r1
        BLNE    copy
        
        LDR     r2, =$zilensym          ; get length of ZI region
        LDR     r0, =$zibasesym         ; load base address of ZI region
        MOV     r1, r0                  ; copy base address of ZI region into r1
        ADD     r1, r1, r2              ; add region length to base address to...
                                        ; ...calculate address of word beyond end...
                                        ; ... of ZI region
        BL      zi_init

        BL	hyhwArm926e_writeBackDcache
        BL	hyhwArm926ejs_drainWriteBuffer
        BL	hyhwArm926ejs_invalidIcacheDcache
        
        MEND

; InitRegions is called from boot.s to initialize the specified execution regions.
; In this example, the regions are called SSRAM and SRAM, to match the PID board.
; These execution region names should match those given in the scatter description file.

InitRegions
        STMFD sp!,{lr}
        
         ;  read buffer, 非overlay 区域
		 macro_RWZI_Init ISRAM_READBUF
		 
		 ;  常驻内存的程序, 非overlay 区域
		 macro_RWZI_Init ISRAM_RESIDE_FUNC
		 
		 ; overlay memory
	     macro_RWZI_Init ISRAM_OVERLAY_MEM
	     
	     ; 全局变量 RW， ZI
	     macro_RWZI_Init ISRAM_RW_ZI
	     
	     ; 由于这个区域是和ALIAS_ISRAM overlay的，一定要在 init完ISRAM_OVERLAY_MEM
	     ; 才能 init它，否则程序又会被冲掉，注意！！！
		 macro_RWZI_Init ISRAM_OVERLAY_FUNC
		 
        LDMFD sp!,{pc}


; --- copy and zi_init subroutines

; copy is a subroutine which copies a region, from an address given by 
; r0 to an address given by r1. The address of the word beyond the end
; of this region is held in r2. r3 is used to hold the word being copied. 
copy
        CMP     r1, r2          ; loop whilst r1 < r2
        LDRLO   r3, [r0], #4
        STRLO   r3, [r1], #4
        BLO     copy
        MOV     pc, lr          ; return from subroutine copy

; zi_init is a subroutine which zero-initialises a region,
; starting at the address in r0. The address of the word
; beyond the end of this region is held in r1.
zi_init
        MOV     r2, #0
        CMP     r0, r1          ; loop whilst r0 < r1
        STRLO   r2, [r0], #4
        BLO     zi_init 
        MOV     pc, lr          ; return from subroutine zi_init

        END

